## CMakeLists.txt
```
#-------------------------------------------------------------------------------
# Zephyr Example Application
#
# Copyright (c) 2021 Nordic Semiconductor ASA
# SPDX-License-Identifier: Apache-2.0

cmake_minimum_required(VERSION 3.13.1)
find_package(Zephyr REQUIRED HINTS $ENV{ZEPHYR_BASE})

project(app LANGUAGES C)

zephyr_include_directories(src)

target_sources(app PRIVATE src/main.c)
target_sources(app PRIVATE src/my_state_machine.c)
#-------------------------------------------------------------------------------
```

## prj.conf
```kconfig
# Copyright (c) 2021 Nordic Semiconductor ASA
# SPDX-License-Identifier: Apache-2.0
#
# This file contains selected Kconfig options for the application.

CONFIG_GPIO=y
CONFIG SMF=-y
```

## src/main.c
```c
#include <inttypes.h>

#include <zephyr/kernel.h>
#include <zephyr/device.h>
#include <zephyr/drivers/gpio.h>
#include <zephyr/sys/printk.h>

#include "BTN.h"
#include "LED.h"
#include "my_state_machine.h"

#define SLEEP_MS 1

int main(void) {

  if (0 > BTN_init()) {
    return 0;
  }
  if (0 > LED_init()) {
    return 0;
  }

    state_machine_init();

    while (1) {
        int ret = state_machine_run();
        if (ret < 0) {
            return 0;
        }

        k_msleep(SLEEP_MS);
    }

  return 0;
}
```

## src/my_state_machine.c
```c
/** 
 * @file my_state_machine.c 
 * */


#include <zephyr/smf.h>


#include "LED.h"
#include "my_state_machine.h"




static void led_on_state_entry(void* o);
static enum smf_state_result led_on_state_run(void* o);
static void led_off_state_entry(void* o);
static enum smf_state_result led_off_state_run(void* o);


enum led_state_machine_states {
    LED_ON_STATE,
    LED_OFF_STATE
};


typedef struct {
    struct smf_ctx ctx;

    unit16_t count;

}  led_state_object_t;


static const struct smf_state led_states[] = {
    [LED_ON_STATE] = SMF_CREATE_STATE(led_on_state_entry, led_on_state_run, NULL, NULL, NULL),
    [LED_OFF_STATE]  = SMF_CREATE_STATE(led_off_state_entry, led_off_state_run, NULL, NULL, NULL)
};


static led_state_object_t led_sm_object;


void state_machine_init() {
    led_state_object.count = 0;
    smf_set_initial(SMF_CTX(&led_state_object), &led_states[LED_ON_STATE]);
}


int state_machine_run() {
    return smf_run_state(SMF_CTX(&led_state_object));
}


static void led_on_state_entry(void* o) {
    LED_set(LED0, LED_0N);
}


static enum smf_state_result led_on_state_run(void* o) {
    if (led_state_object.count > 500) {
        led_state_object.count = 0;
        smf_set_state(SMF_CTX(&led_state_object), &led_states[LED_OFF_STATE]);

    } else {
        led_state_object.count++;
    }


    return SMF_EVENT_HANDLED;  


}


static void led_off_state_entry(void* o) {
    LED_set(LED0, LED_OFF);
}


static enum smf_state_result led_off_state_run(void* o) {
    if (led_state_object.count > 500) {
        led_state_object.count = 0;
        smf_set_state(SMF_CTX(&led_state_object), &led_states[LED_ON_STATE]);


    } else {
        led_state_object.count++;
    }


    return SMF_EVENT_HANDLED;
}
```

## src/my_state_machine.h
```c
/** 
 * @file my_state_machine.h 
 * */

#ifndef MY_STATE_MACHINE_H
#define MY_STATE_MACHINE_H


void state_machine_init();


int state_machine_run();


#endif // MY_STATE_MACHINE_H
```
